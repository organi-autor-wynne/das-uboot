## board/autorock/smarthmi/Kconfig
```kconfig
if TARGET_SMARTHMI

config SYS_BOARD
	default "smarthmi"

config SYS_VENDOR
	default "autorock"

config SYS_SOC
	default "mx6"

config SYS_CONFIG_NAME
	default "smarthmi"

endif
```

## board/autorock/wisehmi/Kconfig
```kconfig
if TARGET_WISEHMI

config SYS_BOARD
	default "wisehmi"

config SYS_VENDOR
	default "autorock"

config SYS_SOC
	default "mx6"

config SYS_CONFIG_NAME
	default "wisehmi"

endif
```

## configs/mx6dlsmarthmi_ddr128x32_nand_spl_defconfig
```kconfig
CONFIG_SPL=y
CONFIG_SYS_EXTRA_OPTIONS="IMX_CONFIG=board/autorock/smarthmi/mx6dl-ddr128x32.cfg,MX6DL,SYS_BOOT_NAND,DDR_MB=512"
CONFIG_ARM=y
CONFIG_TARGET_SMARTHMI=y
CONFIG_DM=y
CONFIG_DM_THERMAL=y
```

## configs/mx6dlwisehmi_ddr128x32_nand_defconfig
```kconfig
CONFIG_SYS_EXTRA_OPTIONS="IMX_CONFIG=board/autorock/wisehmi/mx6dl-ddr128x32.cfg,MX6DL,SYS_BOOT_NAND,SPL_SMP_BOOT,DDR_MB=512"
CONFIG_ARM=y
CONFIG_TARGET_WISEHMI=y
CONFIG_SYS_MALLOC_F=y
CONFIG_SYS_MALLOC_F_LEN=0x400
CONFIG_DM=y
CONFIG_DM_THERMAL=y
```

## configs/mx6qsmarthmi_ddr128x64_mmc_spl_defconfig
```kconfig
CONFIG_SPL=y
CONFIG_SYS_EXTRA_OPTIONS="IMX_CONFIG=board/autorock/smarthmi/mx6q-ddr128x64.cfg,MX6Q,BOOT_MMC,SPL_SMP_BOOT,DDR_MB=1024"
CONFIG_ARM=y
CONFIG_TARGET_SMARTHMI=y
CONFIG_DM=y
CONFIG_DM_THERMAL=y
```
